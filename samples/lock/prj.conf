## CMakeLists.txt
```
#
# Copyright (c) 2021, Nordic Semiconductor ASA
# All rights reserved.
#
# Use in source and binary forms, redistribution in binary form only, with
# or without modification, are permitted provided that the following conditions
# are met:
#
# 1. Redistributions in binary form, except as embedded into a Nordic
#    Semiconductor ASA integrated circuit in a product or a software update for
#    such product, must reproduce the above copyright notice, this list of
#    conditions and the following disclaimer in the documentation and/or other
#    materials provided with the distribution.
#
# 2. Neither the name of Nordic Semiconductor ASA nor the names of its
#    contributors may be used to endorse or promote products derived from this
#    software without specific prior written permission.
#
# 3. This software, with or without modification, must only be used with a Nordic
#    Semiconductor ASA integrated circuit.
#
# 4. Any software provided in binary form under this license must not be reverse
#    engineered, decompiled, modified and/or disassembled.
#
# THIS SOFTWARE IS PROVIDED BY NORDIC SEMICONDUCTOR ASA "AS IS" AND ANY EXPRESS OR
# IMPLIED WARRANTIES, INCLUDING, BUT NOT LIMITED TO, THE IMPLIED WARRANTIES OF
# MERCHANTABILITY, NONINFRINGEMENT, AND FITNESS FOR A PARTICULAR PURPOSE ARE
# DISCLAIMED. IN NO EVENT SHALL NORDIC SEMICONDUCTOR ASA OR CONTRIBUTORS BE LIABLE
# FOR ANY DIRECT, INDIRECT, INCIDENTAL, SPECIAL, EXEMPLARY, OR CONSEQUENTIAL
# DAMAGES (INCLUDING, BUT NOT LIMITED TO, PROCUREMENT OF SUBSTITUTE GOODS OR
# SERVICES; LOSS OF USE, DATA, OR PROFITS; OR BUSINESS INTERRUPTION) HOWEVER
# CAUSED AND ON ANY THEORY OF LIABILITY, WHETHER IN CONTRACT, STRICT LIABILITY, OR
# TORT (INCLUDING NEGLIGENCE OR OTHERWISE) ARISING IN ANY WAY OUT OF THE USE OF
# THIS SOFTWARE, EVEN IF ADVISED OF THE POSSIBILITY OF SUCH DAMAGE.
#

cmake_minimum_required(VERSION 3.20.0)

set(COMMON_ROOT $ENV{ZEPHYR_BASE}/../homekit/samples/common)

# Common configuration
include(${COMMON_ROOT}/CMakeLists.txt)

find_package(Zephyr HINTS $ENV{ZEPHYR_BASE})
project(homekit_lock)

target_sources(app PRIVATE ${CMAKE_CURRENT_SOURCE_DIR}/src/app.c)
target_sources(app PRIVATE ${CMAKE_CURRENT_SOURCE_DIR}/src/tag_reader.c)
target_sources(app PRIVATE ${COMMON_ROOT}/src/main.c)
target_sources(app PRIVATE ${COMMON_ROOT}/src/hap.c)

target_sources(app PRIVATE
  ${ZEPHYR_BASE}/../homekit/adk/Applications/AppBase.c
  ${ZEPHYR_BASE}/../homekit/adk/Applications/Lock/DB.c
  ${ZEPHYR_BASE}/../homekit/adk/Applications/Lock/DebugCommandHandler.c
  ${ZEPHYR_BASE}/../homekit/adk/Applications/Common/Platform/nRFConnect/AppLED.c
  ${ZEPHYR_BASE}/../homekit/adk/Applications/Common/Platform/nRFConnect/AppUserInput.c
  ${ZEPHYR_BASE}/../homekit/adk/Applications/Common/Platform/nRFConnect/BLEStatusLED.c
  ${ZEPHYR_BASE}/../homekit/adk/Applications/Common/Platform/nRFConnect/ThreadStatusLED.c
  ${ZEPHYR_BASE}/../homekit/adk/Applications/Common/Platform/nRFConnect/DFUStatusLED.c
  ${ZEPHYR_BASE}/../homekit/adk/Applications/Common/Platform/nRFConnect/PowerManagment.c
)

target_include_directories(app PRIVATE
  ${ZEPHYR_BASE}/../homekit/adk/Applications
  ${ZEPHYR_BASE}/../homekit/adk/Applications/Lock
  ${ZEPHYR_BASE}/../homekit/adk/Applications/Common/DB
  ${ZEPHYR_BASE}/../homekit/adk/Applications/Common/Helper
  ${ZEPHYR_BASE}/../homekit/adk/Applications/Common/Platform
)

if(CMAKE_EXPORT_COMPILE_COMMANDS)
add_custom_command(TARGET app
    POST_BUILD
    COMMAND ${CMAKE_COMMAND} -E copy compile_commands.json ${ZEPHYR_BASE}/../compile_commands.json
)
endif()
```

## Kconfig
```
#
# Copyright (c) 2021, Nordic Semiconductor ASA
# All rights reserved.
#
# Use in source and binary forms, redistribution in binary form only, with
# or without modification, are permitted provided that the following conditions
# are met:
#
# 1. Redistributions in binary form, except as embedded into a Nordic
#    Semiconductor ASA integrated circuit in a product or a software update for
#    such product, must reproduce the above copyright notice, this list of
#    conditions and the following disclaimer in the documentation and/or other
#    materials provided with the distribution.
#
# 2. Neither the name of Nordic Semiconductor ASA nor the names of its
#    contributors may be used to endorse or promote products derived from this
#    software without specific prior written permission.
#
# 3. This software, with or without modification, must only be used with a Nordic
#    Semiconductor ASA integrated circuit.
#
# 4. Any software provided in binary form under this license must not be reverse
#    engineered, decompiled, modified and/or disassembled.
#
# THIS SOFTWARE IS PROVIDED BY NORDIC SEMICONDUCTOR ASA "AS IS" AND ANY EXPRESS OR
# IMPLIED WARRANTIES, INCLUDING, BUT NOT LIMITED TO, THE IMPLIED WARRANTIES OF
# MERCHANTABILITY, NONINFRINGEMENT, AND FITNESS FOR A PARTICULAR PURPOSE ARE
# DISCLAIMED. IN NO EVENT SHALL NORDIC SEMICONDUCTOR ASA OR CONTRIBUTORS BE LIABLE
# FOR ANY DIRECT, INDIRECT, INCIDENTAL, SPECIAL, EXEMPLARY, OR CONSEQUENTIAL
# DAMAGES (INCLUDING, BUT NOT LIMITED TO, PROCUREMENT OF SUBSTITUTE GOODS OR
# SERVICES; LOSS OF USE, DATA, OR PROFITS; OR BUSINESS INTERRUPTION) HOWEVER
# CAUSED AND ON ANY THEORY OF LIABILITY, WHETHER IN CONTRACT, STRICT LIABILITY, OR
# TORT (INCLUDING NEGLIGENCE OR OTHERWISE) ARISING IN ANY WAY OUT OF THE USE OF
# THIS SOFTWARE, EVEN IF ADVISED OF THE POSSIBILITY OF SUCH DAMAGE.
#

mainmenu "Lock sample"

menu "Accessory configuration"
rsource "${ZEPHYR_BASE}/../homekit/samples/common/Kconfig"
endmenu

menu "Zephyr Kernel"
source "${ZEPHYR_BASE}/Kconfig.zephyr"
endmenu
```

## sample.yaml
```
sample:
  name: HomeKit Lock
  description: HomeKit Lock sample
tests:
  sample.homekit.lock.ble.nfc.debug:
    build_only: true
    extra_args: NFC=y DEBUG=y
    integration_platforms:
      - nrf52833dk_nrf52833
    platform_allow: nrf52833dk_nrf52833 nrf21540dk_nrf52840
    tags: bluetooth ci_build
  sample.homekit.lock.ble.qrc.ndfu.release:
    build_only: true
    extra_args: NORDIC_DFU=y
    integration_platforms:
      - nrf5340dk_nrf5340_cpuapp
    platform_allow: nrf52840dk_nrf52840 nrf5340dk_nrf5340_cpuapp
    tags: bluetooth ci_build
  sample.homekit.lock.multiprotocol.mtd.eui.nfc.hdfu.release:
    build_only: true
    extra_args: THREAD=y MTD=y EUI64=y NFC=y
    integration_platforms:
      - nrf52840dk_nrf52840
      - nrf5340dk_nrf5340_cpuapp
    platform_allow: nrf52840dk_nrf52840 nrf21540dk_nrf52840 nrf5340dk_nrf5340_cpuapp
    tags: bluetooth thread ci_build
  sample.homekit.lock.multiprotocol.mtd.eui.nfc.ndfu.debug:
    build_only: true
    extra_args: THREAD=y MTD=y EUI64=y NFC=y NORDIC_DFU=y DEBUG=y
    integration_platforms:
      - nrf5340dk_nrf5340_cpuapp
    platform_allow: nrf52840dk_nrf52840 nrf5340dk_nrf5340_cpuapp
    tags: bluetooth thread ci_build
```

## prj.conf
```kconfig
#
# Copyright (c) 2021, Nordic Semiconductor ASA
# All rights reserved.
#
# Use in source and binary forms, redistribution in binary form only, with
# or without modification, are permitted provided that the following conditions
# are met:
#
# 1. Redistributions in binary form, except as embedded into a Nordic
#    Semiconductor ASA integrated circuit in a product or a software update for
#    such product, must reproduce the above copyright notice, this list of
#    conditions and the following disclaimer in the documentation and/or other
#    materials provided with the distribution.
#
# 2. Neither the name of Nordic Semiconductor ASA nor the names of its
#    contributors may be used to endorse or promote products derived from this
#    software without specific prior written permission.
#
# 3. This software, with or without modification, must only be used with a Nordic
#    Semiconductor ASA integrated circuit.
#
# 4. Any software provided in binary form under this license must not be reverse
#    engineered, decompiled, modified and/or disassembled.
#
# THIS SOFTWARE IS PROVIDED BY NORDIC SEMICONDUCTOR ASA "AS IS" AND ANY EXPRESS OR
# IMPLIED WARRANTIES, INCLUDING, BUT NOT LIMITED TO, THE IMPLIED WARRANTIES OF
# MERCHANTABILITY, NONINFRINGEMENT, AND FITNESS FOR A PARTICULAR PURPOSE ARE
# DISCLAIMED. IN NO EVENT SHALL NORDIC SEMICONDUCTOR ASA OR CONTRIBUTORS BE LIABLE
# FOR ANY DIRECT, INDIRECT, INCIDENTAL, SPECIAL, EXEMPLARY, OR CONSEQUENTIAL
# DAMAGES (INCLUDING, BUT NOT LIMITED TO, PROCUREMENT OF SUBSTITUTE GOODS OR
# SERVICES; LOSS OF USE, DATA, OR PROFITS; OR BUSINESS INTERRUPTION) HOWEVER
# CAUSED AND ON ANY THEORY OF LIABILITY, WHETHER IN CONTRACT, STRICT LIABILITY, OR
# TORT (INCLUDING NEGLIGENCE OR OTHERWISE) ARISING IN ANY WAY OUT OF THE USE OF
# THIS SOFTWARE, EVEN IF ADVISED OF THE POSSIBILITY OF SUCH DAMAGE.
#
################################################################################
# Realese configuration

# Firmware version
CONFIG_MCUBOOT_IMAGE_VERSION="1.0.0+0"

# Bootloader Configuration
CONFIG_BOOTLOADER_MCUBOOT=y

# Miscellaneous
CONFIG_MPU_STACK_GUARD=y
CONFIG_HEAP_MEM_POOL_SIZE=1024
CONFIG_ASSERT=n
CONFIG_DK_LIBRARY=y
CONFIG_REBOOT=y
CONFIG_BOOT_BANNER=n

# Disable logs
CONFIG_LOG=n
CONFIG_SERIAL=n
CONFIG_SHELL_LOG_BACKEND=n
CONFIG_HAP_SHELL=n
CONFIG_USE_SEGGER_RTT=n
CONFIG_SERIAL=n
CONFIG_CONSOLE=n
CONFIG_UART_CONSOLE=n

# Stacks
CONFIG_SYSTEM_WORKQUEUE_STACK_SIZE=4492


#CONFIG_SPI=y

CONFIG_ST25R3916_LIB=y
CONFIG_POLL=y



CONFIG_ST25R3916_LIB_LOG_LEVEL_INF=y
CONFIG_LOG_DEFAULT_LEVEL=4
```

## prj_debug.conf
```kconfig
#
# Copyright (c) 2021, Nordic Semiconductor ASA
# All rights reserved.
#
# Use in source and binary forms, redistribution in binary form only, with
# or without modification, are permitted provided that the following conditions
# are met:
#
# 1. Redistributions in binary form, except as embedded into a Nordic
#    Semiconductor ASA integrated circuit in a product or a software update for
#    such product, must reproduce the above copyright notice, this list of
#    conditions and the following disclaimer in the documentation and/or other
#    materials provided with the distribution.
#
# 2. Neither the name of Nordic Semiconductor ASA nor the names of its
#    contributors may be used to endorse or promote products derived from this
#    software without specific prior written permission.
#
# 3. This software, with or without modification, must only be used with a Nordic
#    Semiconductor ASA integrated circuit.
#
# 4. Any software provided in binary form under this license must not be reverse
#    engineered, decompiled, modified and/or disassembled.
#
# THIS SOFTWARE IS PROVIDED BY NORDIC SEMICONDUCTOR ASA "AS IS" AND ANY EXPRESS OR
# IMPLIED WARRANTIES, INCLUDING, BUT NOT LIMITED TO, THE IMPLIED WARRANTIES OF
# MERCHANTABILITY, NONINFRINGEMENT, AND FITNESS FOR A PARTICULAR PURPOSE ARE
# DISCLAIMED. IN NO EVENT SHALL NORDIC SEMICONDUCTOR ASA OR CONTRIBUTORS BE LIABLE
# FOR ANY DIRECT, INDIRECT, INCIDENTAL, SPECIAL, EXEMPLARY, OR CONSEQUENTIAL
# DAMAGES (INCLUDING, BUT NOT LIMITED TO, PROCUREMENT OF SUBSTITUTE GOODS OR
# SERVICES; LOSS OF USE, DATA, OR PROFITS; OR BUSINESS INTERRUPTION) HOWEVER
# CAUSED AND ON ANY THEORY OF LIABILITY, WHETHER IN CONTRACT, STRICT LIABILITY, OR
# TORT (INCLUDING NEGLIGENCE OR OTHERWISE) ARISING IN ANY WAY OUT OF THE USE OF
# THIS SOFTWARE, EVEN IF ADVISED OF THE POSSIBILITY OF SUCH DAMAGE.
#
################################################################################
# Debug configuration

# Firmware version
CONFIG_MCUBOOT_IMAGE_VERSION="1.0.0+0"

# Bootloader Configuration
CONFIG_BOOTLOADER_MCUBOOT=y

# Miscellaneous
CONFIG_MPU_STACK_GUARD=y
CONFIG_HEAP_MEM_POOL_SIZE=1024
CONFIG_ASSERT=n
CONFIG_DK_LIBRARY=y
CONFIG_REBOOT=y
CONFIG_BOOT_BANNER=y

# HomeKit Protocol
CONFIG_HAP_LOG_LEVEL_DEBUG=y
CONFIG_HAP_ASSERTS=y
CONFIG_HAP_PRECONDITIONS=y
CONFIG_HAP_LOG_MESSAGE_MAX_BYTES=512

# Enable logs
CONFIG_LOG=y
CONFIG_LOG_PRINTK=y
CONFIG_LOG_MODE_DEFERRED=y
CONFIG_LOG_BUFFER_SIZE=4096
CONFIG_LOG_BACKEND_RTT_MODE_DROP=y
CONFIG_LOG_BACKEND_RTT_MESSAGE_SIZE=256
CONFIG_LOG_PROCESS_THREAD_STACK_SIZE=1024
CONFIG_SEGGER_RTT_BUFFER_SIZE_UP=4096
CONFIG_USE_SEGGER_RTT=y
CONFIG_RTT_CONSOLE=y

# Footprint size optimization
# In case of error, disable minimal configuration to get more detailed logs.
CONFIG_MINIMAL_ASSERTS_LOGS=y
CONFIG_MINIMAL_PRECONDITIONS_LOGS=y
CONFIG_MINIMAL_FATAL_ERROR_LOGS=n

# SHELL configuration
CONFIG_SHELL=y
CONFIG_HAP_SHELL=y
CONFIG_SHELL_LOG_BACKEND=n

# Debug miscellaneous
CONFIG_RESET_ON_FATAL_ERROR=n

# Stacks
CONFIG_SYSTEM_WORKQUEUE_STACK_SIZE=4492

CONFIG_SPI=y

CONFIG_ST25R3916_LIB=y
CONFIG_POLL=y



CONFIG_ST25R3916_LIB_LOG_LEVEL_INF=n
CONFIG_LOG_DEFAULT_LEVEL=4
```

## boards/nrf5340dk_nrf5340_cpuapp.conf
```kconfig
# Copyright (c) 2021 Nordic Semiconductor ASA
#
# SPDX-License-Identifier: LicenseRef-Nordic-5-Clause
#

# Place for additional configuration
CONFIG_NORDIC_SECURITY_BACKEND=y
CONFIG_HEAP_MEM_POOL_SIZE=4092

CONFIG_UPDATEABLE_IMAGE_NUMBER=2

CONFIG_IMG_MANAGER=y
CONFIG_MCUBOOT_IMG_MANAGER=y
CONFIG_IMG_ERASE_PROGRESSIVELY=y

CONFIG_BT_BUF_ACL_TX_SIZE=251
```

## src/tag_reader.c
```c
/* main.c - Application main entry point */

/*
 * Copyright (c) 2019 Nordic Semiconductor ASA
 *
 * SPDX-License-Identifier: LicenseRef-Nordic-5-Clause
 */

#include <zephyr/types.h>
#include <stddef.h>
#include <stdbool.h>
#include <string.h>
#include <zephyr/kernel.h>
#include <zephyr/sys/printk.h>
#include <st25r3911b_nfca.h>
#include <nfc/ndef/msg_parser.h>
#include <nfc/ndef/le_oob_rec_parser.h>
#include <nfc/t2t/parser.h>
#include <nfc/t4t/ndef_file.h>
#include <nfc/t4t/isodep.h>
#include <nfc/t4t/hl_procedure.h>
#include <nfc/ndef/ch_rec_parser.h>
#include <zephyr/sys/byteorder.h>
#include <st25r3916_nfca.h>
#include "st25r3916_irq.h"
#if 1
#define MY_STACK_SIZE 1024
#define MY_PRIORITY -2
static K_SEM_DEFINE(irq_sem, 0, 1);
int is=0;
void my_entry_point(int unused1, int unused2, int unused3)
{
	int err;
	while(1){
/*		err = k_sem_take(&irq_sem, K_FOREVER);
		if (err) {
			return;
		}
		st25r3916Isr();*/
		printk("my_entry_point\n");
k_sleep(K_SECONDS(1));
	}

}

K_THREAD_STACK_DEFINE(my_stack_area, MY_STACK_SIZE);
#endif
void tag_reader(int unused1, int unused2, int unused3)
{
	int err;

#if 0
	nfc_t4t_hl_procedure_cb_register(&t4t_hl_procedure_cb);

	k_work_init_delayable(&transmit_work, transfer_handler);

	err = nfc_t4t_isodep_init(tx_data, sizeof(tx_data),
				  t4t.data, sizeof(t4t.data),
				  &t4t_isodep_cb);
	if (err) {
		printk("NFC T4T ISO-DEP Protocol initialization failed err: %d.\n",
		       err);
		return;
	}
/*
	err = st25r3911b_nfca_init(events, ARRAY_SIZE(events), &cb);
	if (err) {
		printk("NFCA initialization failed err: %d.\n", err);
		return;
	}

	err = st25r3911b_nfca_field_on();
	if (err) {
		printk("Field on error %d.", err);
		return;
	}

	while (true) {
		k_poll(events, ARRAY_SIZE(events), K_FOREVER);
		err = st25r3911b_nfca_process();
		if (err) {
			printk("NFC-A process failed, err: %d.\n", err);
			return;
		}
	}*/
#endif
#if 1
st25r3916InitInterrupts(&irq_sem);
struct k_thread my_thread_data;
	
	k_tid_t my_tid = k_thread_create(&my_thread_data, my_stack_area,
									 K_THREAD_STACK_SIZEOF(my_stack_area),
									 my_entry_point,
									 NULL, NULL, NULL,
									 MY_PRIORITY, 0, K_NO_WAIT);
#endif
	err = st25r3916_nfca_init();
	if (err) {
		return err;
	}

	while(1)
{	printk("Starting NFC TAG Reader example\n");
k_sleep(K_SECONDS(1));
}
}
K_THREAD_DEFINE(tag, 2048, tag_reader, NULL, NULL, NULL, 5, 0, 0);
```
